## Kconfig
```kconfig
# Stack root Kconfig (ByteBlue-decoupled)
# Provides a clean entry point for menuconfig, and stubs for a few external symbols.

mainmenu "ByteBlue Bluetooth Configuration"

config BIG_ENDIAN
	bool "Big-endian"
	default n
	help
	  This option tells the build system that the target system is big-endian.
	  Little-endian architecture is the default and should leave this option
	  unselected.

config LITTLE_ENDIAN
	bool "Little-endian"
	depends on !BIG_ENDIAN
	default y
	help
	  This option tells the build system that the target system is little-endian.

config BYTEBLUE_CRYPTO_USE_MBEDTLS
	bool "Use mbed TLS for crypto"
	default y
	help
	  This option enables using mbed TLS for crypto operations.

config BYTEBLUE_BT_DRIVER
	bool "Enable Bluetooth driver"
	default y
	help
	  This option enables building the Bluetooth driver.

if BYTEBLUE_BT_DRIVER
choice BYTEBLUE_BT_DRIVER_TYPE
	prompt "Bluetooth driver type"
	default BYTEBLUE_BT_DRIVER_TYPE_NATIVE
	help
	  Select the Bluetooth driver type to use.

config BYTEBLUE_BT_DRIVER_TYPE_H4
	bool "H4 driver"
	help
	  Use the H4 Bluetooth driver.

config BYTEBLUE_BT_DRIVER_TYPE_NATIVE
	bool "Native driver"
	help
	  Use the native Bluetooth driver.

config BYTEBLUE_BT_DRIVER_TYPE_LIBUSB
	bool "LIBUSB driver"
	help
	  Use the LIBUSB Bluetooth driver.

config BYTEBLUE_BT_DRIVER_TYPE_USERCHAN
	bool "socket User channel driver"
	help
	  Use the user channel Bluetooth driver.
endchoice
endif

config BYTEBLUE_SAMPLES
	bool "Enable samples"
	default n
	help
	  This option enables building samples.

config BYTEBLUE_TESTS
	bool "Enable tests"
	default n
	help
	  This option enables building tests.

choice BYTEBLUE_PLATFORM
	prompt "Target Platform"
	default BYTEBLUE_PLATFORM_LINUX
	help
	    Select the target platform.
	
	config BYTEBLUE_PLATFORM_LINUX
	    bool "Linux platform"
	    help
	        Run on Linux platform.
	
	config BYTEBLUE_PLATFORM_NUTTX
	    bool "NuttX platform"
	    help
	        Run on NuttX platform.

	config BYTEBLUE_PLATFORM_WINDOWS
	    bool "Windows platform"
	    help
	        Run on Windows platform.
endchoice

# Source Bluetooth Kconfig tree (relative paths work with Kconfiglib)
source "bluetooth/Kconfig"
```

## bluetooth/audio/Kconfig
```kconfig
# Bluetooth Audio configuration options

#
# Copyright (c) 2020 Intel Corporation
# Copyright (c) 2022 Nordic Semiconductor ASA
#
# SPDX-License-Identifier: Apache-2.0
#

menuconfig BT_AUDIO
	bool "Bluetooth Audio support"
	help
	  This option enables Bluetooth Audio support. The specific
	  features that are available may depend on other features
	  that have been enabled in the stack, such as Periodic
	  Advertisement for Broadcast and L2CAP Dynamic Channel
	  for Unicast.

if BT_AUDIO

config BT_AUDIO_RX
	def_bool BT_ASCS_ASE_SNK || BT_BAP_UNICAST_CLIENT_ASE_SRC || BT_BAP_BROADCAST_SINK

config BT_AUDIO_TX
	def_bool BT_ASCS_ASE_SRC || BT_BAP_UNICAST_CLIENT_ASE_SNK || BT_BAP_BROADCAST_SOURCE

config BT_AUDIO_NOTIFY_RETRY_DELAY
	int "Delay for notification sending retried attempt in 1.25 ms units"
	range 6 3200
	default 20
	help
	  This option sets the time in 1.25 ms units before the stack will
	  retry to send notification that failed due to lack of TX buffers
	  available.

source "bluetooth/audio/Kconfig.bap"
source "bluetooth/audio/Kconfig.ccp"
source "bluetooth/audio/Kconfig.vocs"
source "bluetooth/audio/Kconfig.aics"
source "bluetooth/audio/Kconfig.vcp"
source "bluetooth/audio/Kconfig.micp"
source "bluetooth/audio/Kconfig.csip"
source "bluetooth/audio/Kconfig.tbs"
source "bluetooth/audio/Kconfig.mcs"
source "bluetooth/audio/Kconfig.has"
source "bluetooth/audio/Kconfig.mpl"
source "bluetooth/audio/Kconfig.mctl"
source "bluetooth/audio/Kconfig.cap"
source "bluetooth/audio/Kconfig.tmap"
source "bluetooth/audio/Kconfig.gmap"
source "bluetooth/audio/Kconfig.pbp"

endif # BT_AUDIO
```

## bluetooth/services/Kconfig
```kconfig
# GATT Services

# Copyright (c) 2018 Nordic Semiconductor ASA
# SPDX-License-Identifier: Apache-2.0

menu "GATT Services"
	depends on BT_CONN

source "bluetooth/services/Kconfig.dis"

source "bluetooth/services/Kconfig.cts"

source "bluetooth/services/Kconfig.hrs"

source "bluetooth/services/Kconfig.tps"

source "bluetooth/services/nus/Kconfig.nus"

source "bluetooth/services/ias/Kconfig.ias"

source "bluetooth/services/ots/Kconfig"

source "bluetooth/services/bas/Kconfig.bas"

endmenu
```
